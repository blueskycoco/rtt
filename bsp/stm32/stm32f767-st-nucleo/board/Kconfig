## bsp/stm32/stm32f767-st-nucleo/board/Kconfig
```kconfig
menu "Hardware Drivers Config"

config SOC_STM32F767ZI 
    bool
    select SOC_SERIES_STM32F7
    select RT_USING_COMPONENTS_INIT
    select RT_USING_USER_MAIN
    default y

menu "Onboard Peripheral Drivers"

    config BSP_USING_USB_TO_USART 
        bool "Enable USB TO USART (uart3)"
        select BSP_USING_UART3
        default y
        
    config BSP_USING_ETH
        bool "Enable Ethernet"
        select RT_USING_LWIP
        default n

        if BSP_USING_ETH
            choice
                prompt "On-board PHY chip"
                default PHY_USING_LAN8742A

                config PHY_USING_LAN8720A
                    bool "LAN8720A"

                config PHY_USING_DM9161CEP
                    bool "DM9161CEP"

                config PHY_USING_LAN8742A
                    bool "LAN8742A"
            endchoice
        endif
 
endmenu

menu "On-chip Peripheral Drivers"

    config BSP_USING_GPIO
        bool "Enable GPIO"
        select RT_USING_PIN
        default y

    config BSP_USING_ON_CHIP_FLASH
        bool "Enable on-chip FLASH"
        default n

    menuconfig BSP_USING_ONCHIP_RTC
        bool "Enable RTC"
        select RT_USING_RTC
        default n
        if BSP_USING_ONCHIP_RTC
            choice
                prompt "Select clock source"
                default BSP_RTC_USING_LSE

                config BSP_RTC_USING_LSE
                    bool "RTC USING LSE"

                config BSP_RTC_USING_LSI
                    bool "RTC USING LSI"
            endchoice
        endif

    menuconfig BSP_USING_UART
        bool "Enable UART3"
        default y
        select RT_USING_SERIAL
        if BSP_USING_UART
            config BSP_USING_UART3
                bool "Enable UART3"
                default y

            config BSP_UART3_RX_USING_DMA
                bool "Enable UART3 RX DMA"
                depends on BSP_USING_UART3 && RT_SERIAL_USING_DMA
                default n
        endif
    source "../libraries/HAL_Drivers/Kconfig"
    
endmenu

menu "Board extended module Drivers"

endmenu
 
endmenu
```
